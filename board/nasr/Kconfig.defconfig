## board/nasr/Kconfig.defconfig
```kconfig
# STM32H723ZG Nucleo board configuration

# Copyright (c) 2020 Alexander Kozhinov <ak.alexander.kozhinov@gmail.com>
# SPDX-License-Identifier: Apache-2.0

if BOARD_NASR

if NETWORKING

config NET_L2_ETHERNET
	default y

endif # NETWORKING

endif # BOARD_NASR
```

## board/nasr/board.yml
```yaml
board:
  name: nasr
  full_name: NASR
  vendor: st
  socs:
    - name: stm32h723xx
```

## driver-gpio-tca6416/Kconfig.tca6416a
```kconfig
# TCA6416A configuration options

# Nazim; electrodyssey.net 2026
# Copyright (c) 2022 Chromium OS Authors
# SPDX-License-Identifier: Apache-2.0

menuconfig GPIO_TCA6416A
	bool "TCA6416A driver"
	default y
	depends on DT_HAS_TI_TCA6416A_ENABLED
	depends on I2C
	help
	  Enable driver for TCA6416A I2C IO expander chip.
	  The TCA6416A provides 16 GPIO pins (2 x 8-bit ports) over I2C.

config GPIO_TCA6416A_INIT_PRIORITY
	int "Init priority"
	default 70
	depends on GPIO_TCA6416A
	help
	  Device driver initialization priority.
```
