## driver-clock-lmk03328/Kconfig.lmk03328
```kconfig
# Copyright (c) 2024 NASR
# SPDX-License-Identifier: Apache-2.0

config LMK03328
	bool "TI LMK03328 clock generator driver"
	default y
	depends on DT_HAS_TI_LMK03328_ENABLED
	select I2C
	help
	  Enable driver for the Texas Instruments LMK03328 I2C clock
	  generator. On initialization the driver writes all register values
	  defined in the device tree node to the device, programming the
	  desired clock configuration.

if LMK03328

config LMK03328_INIT_PRIORITY
	int "Init priority"
	default 90
	help
	  Device driver initialization priority. The I2C bus must be ready
	  before this driver initializes, so this value must be higher than
	  the I2C controller init priority (typically 50).

config LMK03328_LOG_LEVEL
	int "Log level"
	default 3
	range 0 4
	help
	  Log level for the LMK03328 driver.
	  0=OFF, 1=ERROR, 2=WARNING, 3=INFO, 4=DEBUG

endif # LMK03328
```

## driver-clock-lmk03328/dts/bindings/clock/ti,lmk03328.yaml
```yaml
# Copyright (c) 2024 NASR
# SPDX-License-Identifier: Apache-2.0

description: |
  Texas Instruments LMK03328 I2C clock generator.

  The driver writes a flat list of register settings to the device during
  boot. Each entry in reg-values is a 16-bit encoded word where the most
  significant byte is the register address and the least significant byte
  is the value to write.

  Example DTS node (I2C address 0x5A):

    lmk03328: lmk03328@5a {
        compatible = "ti,lmk03328";
        reg = <0x5a>;
        status = "okay";
        reg-values = <
            0x0010  /* R0  = 0x10 */
            0x010B  /* R1  = 0x0B */
            0x0232  /* R2  = 0x32 */
        >;
    };

compatible: "ti,lmk03328"

include: i2c-device.yaml

properties:
  init-priority:
    type: int
    description: |
      Driver initialization priority. Overrides CONFIG_LMK03328_INIT_PRIORITY
      for this specific device instance. The I2C bus must be ready before this
      driver initializes, so this value must be higher than the I2C controller
      init priority (typically 50).

  software-reset:
    type: boolean
    description: |
      When present, a software reset is issued after all registers have been
      written. The reset is performed by clearing bit 7 of R12 (register
      address 0x0C) via a read-modify-write operation.

  reg-values:
    type: array
    required: true
    description: |
      Register initialization sequence for the LMK03328.

      Each entry is a 16-bit encoded value:
        bits[15:8] - register address (0x00 .. 0xAC)
        bits[7:0]  - register value to write

      The registers are written in the order they appear in the array.
      Values are generated by the TICS Pro configuration tool and exported
      as hex register values (e.g. PS33.33-SZG64.8-HexRegisterValues.txt).
```

## driver-gpio-tca6408/Kconfig.tca6408a
```kconfig
# TCA6408A configuration options

# Nazim; electrodyssey.net 2026
# Copyright (c) 2022 Chromium OS Authors
# SPDX-License-Identifier: Apache-2.0

menuconfig GPIO_TCA6408A
	bool "TCA6408A driver"
	default y
	depends on DT_HAS_TI_TCA6408A_ENABLED
	depends on I2C
	help
	  Enable driver for TCA6408A I2C IO expander chip.
	  The TCA6408A provides 8 GPIO pins (1 x 8-bit port) over I2C.

config GPIO_TCA6408A_INIT_PRIORITY
	int "Init priority"
	default 70
	depends on GPIO_TCA6408A
	help
	  Device driver initialization priority.
```

## driver-gpio-tca6408/dts/bindings/gpio/ti,tca6408a.yaml
```yaml
# Nazim; electrodyssey.net 2026
# Copyright (c) 2022 Chromium OS Authors
# SPDX-License-Identifier: Apache-2.0

description: |
  Texas Instruments TCA6408A 8-bit I2C GPIO expander.

  The TCA6408A provides 8 GPIO pins over a single I2C interface.
  It supports an open-drain interrupt output and an active-low hardware
  reset line.

  Example devicetree node:

    &i2c0 {
      tca6408a: gpio@20 {
        compatible = "ti,tca6408a";
        reg = <0x20>;
        gpio-controller;
        #gpio-cells = <2>;
        ngpios = <8>;

        /* optional interrupt line (active-low, open-drain) */
        int-gpios = <&gpio0 4 (GPIO_ACTIVE_LOW | GPIO_PULL_UP)>;

        /* optional hardware reset line (active-low) */
        reset-gpios = <&gpio0 5 GPIO_ACTIVE_LOW>;
      };
    };

  Pin numbering maps directly to the 8 port pins P0–P7.

compatible: "ti,tca6408a"

include:
  - name: base.yaml
  - name: gpio-controller.yaml
  - name: i2c-device.yaml

properties:
  reg:
    required: true
    description: |
      I2C device address. The TCA6408A can be configured for two
      addresses depending on the ADDR pin:
        0x20  (ADDR tied LOW)
        0x21  (ADDR tied HIGH)

  "#gpio-cells":
    const: 2
    description: |
      Two cells are required: <pin flags>.
        pin   – GPIO pin number (0–7).
        flags – GPIO flags (e.g. GPIO_ACTIVE_LOW).

  int-gpios:
    type: phandle-array
    required: false
    description: |
      Phandle and GPIO specifier for the host GPIO connected to the
      active-low, open-drain INT pin of the TCA6408A. When configured,
      input-state changes on the expander will trigger an interrupt on the
      host and the driver will fire the registered GPIO callbacks.

  reset-gpios:
    type: phandle-array
    required: false
    description: |
      Phandle and GPIO specifier for the host GPIO connected to the
      active-low RESET pin of the TCA6408A. When provided the driver
      issues a hardware reset during initialisation. If omitted the
      polarity-inversion register is cleared in software instead.

gpio-cells:
  - pin
  - flags
```
