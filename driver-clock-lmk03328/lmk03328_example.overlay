/*
 * Example DTS overlay for LMK03328 clock generator.
 *
 * Register values exported from TICS Pro:
 *   PS33.33-SZG64.8-HexRegisterValues.txt
 *
 * Format: each entry = (reg_addr << 8) | reg_value
 */

&i2c0 {
	lmk03328: lmk03328@5a {
		compatible = "ti,lmk03328";
		reg = <0x54>;
		init-priority = <90>;
		software-reset;    /* clear R12[7] after writing all registers */
		status = "okay";

		reg-values = <
			0x0010  /* R0   */
			0x010B  /* R1   */
			0x0232  /* R2   */
			0x0300  /* R3   */
			0x0400  /* R4   */
			0x0500  /* R5   */
			0x0600  /* R6   */
			0x0700  /* R7   */
			0x0800  /* R8   */
			0x0900  /* R9   */
			0x0A00  /* R10  */
			0x0B00  /* R11  */
			0x0CDF  /* R12  */
			0x0D00  /* R13  */
			0x0E00  /* R14  */
			0x0F00  /* R15  */
			0x1000  /* R16  */
			0x1100  /* R17  */
			0x1200  /* R18  */
			0x1300  /* R19  */
			0x14FF  /* R20  */
			0x15FF  /* R21  */
			0x16FF  /* R22  */
			0x1702  /* R23  */
			0x1800  /* R24  */
			0x19F5  /* R25  */
			0x1A00  /* R26  */
			0x1B58  /* R27  */
			0x1C28  /* R28  */
			0x1D02  /* R29  */
			0x1E0C  /* R30  */
			0x1F20  /* R31  */
			0x2030  /* R32  */
			0x2113  /* R33  */
			0x2230  /* R34  */
			0x237C  /* R35  */
			0x2413  /* R36  */
			0x2510  /* R37  */
			0x262F  /* R38  */
			0x2710  /* R39  */
			0x282F  /* R40  */
			0x2950  /* R41  */
			0x2A27  /* R42  */
			0x2B50  /* R43  */
			0x2C27  /* R44  */
			0x2D0A  /* R45  */
			0x2E00  /* R46  */
			0x2F00  /* R47  */
			0x30FF  /* R48  */
			0x3100  /* R49  */
			0x3285  /* R50  */
			0x3303  /* R51  */
			0x3400  /* R52  */
			0x3500  /* R53  */
			0x3600  /* R54  */
			0x3700  /* R55  */
			0x381E  /* R56  */
			0x3915  /* R57  */
			0x3A00  /* R58  */
			0x3B62  /* R59  */
			0x3C00  /* R60  */
			0x3D00  /* R61  */
			0x3E22  /* R62  */
			0x3F00  /* R63  */
			0x4000  /* R64  */
			0x412D  /* R65  */
			0x4203  /* R66  */
			0x431A  /* R67  */
			0x4403  /* R68  */
			0x457D  /* R69  */
			0x4607  /* R70  */
			0x4706  /* R71  */
			0x4818  /* R72  */
			0x4900  /* R73  */
			0x4A60  /* R74  */
			0x4B00  /* R75  */
			0x4C00  /* R76  */
			0x4D00  /* R77  */
			0x4E00  /* R78  */
			0x4F00  /* R79  */
			0x5001  /* R80  */
			0x510C  /* R81  */
			0x5208  /* R82  */
			0x5301  /* R83  */
			0x5404  /* R84  */
			0x5507  /* R85  */
			0x5600  /* R86  */
			0x5700  /* R87  */
			0x5800  /* R88  */
			0x59DE  /* R89  */
			0x5A01  /* R90  */
			0x5B18  /* R91  */
			0x5C01  /* R92  */
			0x5D4B  /* R93  */
			0x5E01  /* R94  */
			0x5F86  /* R95  */
			0x6001  /* R96  */
			0x61BE  /* R97  */
			0x6201  /* R98  */
			0x63FE  /* R99  */
			0x6402  /* R100 */
			0x6547  /* R101 */
			0x6602  /* R102 */
			0x679E  /* R103 */
			0x6800  /* R104 */
			0x6900  /* R105 */
			0x6A05  /* R106 */
			0x6B0F  /* R107 */
			0x6C0F  /* R108 */
			0x6D0F  /* R109 */
			0x6E0F  /* R110 */
			0x6F00  /* R111 */
			0x7000  /* R112 */
			0x7100  /* R113 */
			0x7200  /* R114 */
			0x7308  /* R115 */
			0x7419  /* R116 */
			0x7580  /* R117 */
			0x7607  /* R118 */
			0x7705  /* R119 */
			0x7800  /* R120 */
			0x790F  /* R121 */
			0x7A0F  /* R122 */
			0x7B0F  /* R123 */
			0x7C0F  /* R124 */
			0x7D00  /* R125 */
			0x7E00  /* R126 */
			0x7F00  /* R127 */
			0x8000  /* R128 */
			0x8108  /* R129 */
			0x8219  /* R130 */
			0x8300  /* R131 */
			0x8407  /* R132 */
			0x8505  /* R133 */
			0x8600  /* R134 */
			0x8700  /* R135 */
			0x8800  /* R136 */
			0x8910  /* R137 */
			0x8A00  /* R138 */
			0x8B00  /* R139 */
			0x8C00  /* R140 */
			0x8D00  /* R141 */
			0x8E00  /* R142 */
			0x8F00  /* R143 */
			0x9000  /* R144 */
			0x9100  /* R145 */
			0xA940  /* R169 */
			0xAC24  /* R172 */
			0xAD00  /* R173 */
		>;
	};
};
